## conf/layer.conf
```bitbake
BBPATH .= ":${LAYERDIR}"
BBFILES += "${LAYERDIR}/recipes-*/*/*.bbappend"
BBFILE_COLLECTIONS += "phyflex_stm32mp2_m33"
BBFILE_PATTERN_phyflex_stm32mp2_m33 = "^${LAYERDIR}/"
BBFILE_PRIORITY_phyflex_stm32mp2_m33 = "100"
LAYERSERIES_COMPAT_phyflex_stm32mp2_m33 = "scarthgap"
LAYERDEPENDS_phyflex_stm32mp2_m33 = "core stm-st-stm32mp phytec"

M33_PRODUCTION_ENABLE ??= "0"
M33_PRODUCTION_ACTIVE = "${@'1' if d.getVar('M33_PRODUCTION_ENABLE') == '1' and d.getVar('MACHINE') == 'stm32mp25x-phyflex-libra-rdk-3' else '0'}"

# Avoid the existing devtool externalsrc and oe-local-files overrides.
# Its source checkout remains untouched.
BBMASK += ".*/workspace/appends/m33projects-stm32mp2[.]bbappend$"
```
